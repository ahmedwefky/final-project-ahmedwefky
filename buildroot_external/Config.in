## buildroot_external/Config.in
```kconfig
source "$BR2_EXTERNAL_REACTION_TIME_MEASUREMENT_APPLICATION_PATH/package/react_driver/Config.in"
```

## buildroot_external/package/aesd_app/Config.in
```kconfig
config BR2_PACKAGE_AESD_APP
	bool "aesd-application"
	help
	  Includes the final project application in the kernel image.
```

## buildroot_external/package/react_app/Config.in
```kconfig
config BR2_PACKAGE_REACT_APP
	bool "react_app"
	help
	  Simple userspace program for the reaction time measurement application.
	  When enabled the application will be built and installed under
	  /usr/bin/react_app.  It opens /dev/react_driver, waits a random
	  interval, arms the driver, and reports the measured reaction time.
```

## buildroot_external/package/react_driver/Config.in
```kconfig
config BR2_PACKAGE_REACT_DRIVER
	bool "react_driver"
	depends on BR2_LINUX_KERNEL
	help
	  Kernel module for the reaction time measurement application.
```
